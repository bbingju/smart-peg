## sdkconfig.defaults
```kconfig
# This is a default configuration for smart-peg
CONFIG_BT_ENABLED=y
CONFIG_BTDM_CONTROLLER_MODE_BLE_ONLY=
CONFIG_BTDM_CONTROLLER_MODE_BR_EDR_ONLY=y
CONFIG_BTDM_CONTROLLER_MODE_BTDM=
CONFIG_CLASSIC_BT_ENABLED=y
CONFIG_WIFI_ENABLED=n
CONFIG_BT_SPP_ENABLED=y
CONFIG_SW_COEXIST_ENABLE=n
CONFIG_ESP_HTTP_CLIENT_ENABLE_HTTPS=n
```
